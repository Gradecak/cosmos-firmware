## boards/nice_nano.conf
```kconfig
CONFIG_CLOCK_CONTROL_NRF_K32SRC_RC=y
CONFIG_CLOCK_CONTROL_NRF_K32SRC_500PPM=y

# USB HID - required explicitly after Zephyr 4.1 upgrade
CONFIG_ZMK_USB=y
CONFIG_USB_DEVICE_STACK=y
CONFIG_USB_DEVICE_HID=y
CONFIG_ZMK_USB_BOOT=y
CONFIG_USB_HID_BOOT_PROTOCOL=y

# BLE - required explicitly after Zephyr 4.1 upgrade
CONFIG_ZMK_BLE=y
CONFIG_BT=y
CONFIG_BT_CTLR=y

# BLE performance
CONFIG_BT_CTLR_TX_PWR_PLUS_8=y

# Debounce tuning - prevent ghost repeats
CONFIG_ZMK_KSCAN_DEBOUNCE_PRESS_MS=5
CONFIG_ZMK_KSCAN_DEBOUNCE_RELEASE_MS=5
```

## boards/shields/cosmos/Kconfig.defconfig
```kconfig
if SHIELD_COSMOS_LEFT

config ZMK_SPLIT_ROLE_CENTRAL
    default y

endif

if SHIELD_COSMOS_LEFT || SHIELD_COSMOS_RIGHT

config ZMK_SPLIT
    default y

config ZMK_KEYBOARD_NAME
    default "Cosmos"

endif
```

## boards/shields/cosmos_test/Kconfig.shield
```kconfig
# Copyright (c) 2023 The ZMK Contributors
# SPDX-License-Identifier: MIT

config SHIELD_COSMOS_TEST
    def_bool $(shields_list_contains,cosmos_test)
```
